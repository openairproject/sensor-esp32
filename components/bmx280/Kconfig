## components/bmx280/Kconfig
```kconfig
menu "OAP BMx280 Sensor"

config OAP_BMX280_ENABLED
    int "enable bmx280 sensor"
    default 1
    help
        todo   

config OAP_BMX280_ADDRESS
    hex "i2c address"
    default 0x76
    help
        Default address for bmx280 sensor is 0x76, it can be set to 0x77 by pulling up SDO pin.
        Adafruit bme280 board is configured for 0x77 as default.

config OAP_BMX280_I2C_NUM
    int "i2c interface number"
    default 0
    help
        todo
        
config OAP_BMX280_I2C_SDA_PIN
    int "gpio SDA pin"
    default 25
    help
        be careful with choosing gpio. i2c pins must be R/W.
        

config OAP_BMX280_I2C_SCL_PIN
    int "SCL pin"
    default 26
    help
        see help for SDA pin
        
config OAP_BMX280_ENABLED_AUX
    int "enable internal bmx280 sensor"
    default 0
    help
        todo     
        
config OAP_BMX280_ADDRESS_AUX
    hex "i2c address of internal sensor"
    default 0x77
    help
    	If both external and internal sensor use the same i2c bus, they must be configured to use
    	different addresses.
        Default address for bmx280 sensor is 0x76, it can be set to 0x77 by pulling up SDO pin.
        Adafruit bme280 board is configured for 0x77 as default.

config OAP_BMX280_I2C_NUM_AUX
    int "i2c interface number for internal sensor"
    default 0
    help
        if both sensors use the same bus (default), sda/scl pins are ignored.
        
config OAP_BMX280_I2C_SDA_PIN_AUX
    int "gpio SDA pin"
    default 25
    help
        be careful with choosing gpio. i2c pins must be R/W.
        

config OAP_BMX280_I2C_SCL_PIN_AUX
    int "SCL pin"
    default 26
    help
        see help for SDA pin        

endmenu
```

## components/bootwifi/Kconfig
```kconfig
menu "OAP WIFI"

config OAP_CONTROL_PANEL
	int "enable control panel"
	default 1
	help
		Enable web-based control panel where you can configure various parameters of the sensor,
		including wifi and data publishing settings
		
config OAP_AP_PASSWORD
	string "AccessPoint password"
	default "cleanair"
	help
		Password to authenticate to WiFi Access Point when sensor runs in this mode.
		Minimum 8 characters.
				
endmenu
```

## components/oap-hw-ext/Kconfig
```kconfig
menu "OAP Peripherals"

config OAP_LED_R_PIN
    int "led Red pin"
    default -1
    help
        ESP32 R/W gpio
        
config OAP_LED_G_PIN
    int "led Green pin"
    default -1
    help
        ESP32 R/W gpio

config OAP_LED_B_PIN
    int "led Blue pin"
    default 2
    help
        ESP32 R/W gpio

config OAP_BTN_0_PIN
    int "button pin"
    default 0
    help
        ESP32 gpio

config OAP_BTN_0_ACTIVE_LOW
    bool "Active low"
    default y
    help
        ESP32 gpio
        
endmenu
```

## components/oap-hw-gpio/Kconfig
```kconfig
menu "OAP Generic GPIO"

config OAP_GPIO_0_ENABLED
    bool "enable GPIO #0"
    default n
    help
        todo   

config OAP_GPIO_OUTPUT0_PIN
    int "GPIO #0 output PIN"
    depends on OAP_GPIO_0_ENABLED
    default 5
    help
        todo

config OAP_GPIO_INPUT0_PIN
    int "GPIO #0 input PIN"
    depends on OAP_GPIO_0_ENABLED
    default 21
    help
        todo

config OAP_GPIO_1_ENABLED
    bool "enable GPIO #1"
    default n
    help
        todo   

config OAP_GPIO_OUTPUT1_PIN
    int "GPIO #1 output PIN"
    depends on OAP_GPIO_1_ENABLED
    default 12
    help
        todo

config OAP_GPIO_INPUT1_PIN
    int "GPIO #1 input PIN"
    depends on OAP_GPIO_1_ENABLED
    default 22
    help
        todo

config OAP_GPIO_2_ENABLED
    bool "enable GPIO #2"
    default n
    help
        todo   

config OAP_GPIO_OUTPUT2_PIN
    int "GPIO #2 output PIN"
    depends on OAP_GPIO_2_ENABLED
    default 18
    help
        todo

config OAP_GPIO_INPUT2_PIN
    int "GPIO #2 input PIN"
    depends on OAP_GPIO_2_ENABLED
    default 36
    help
        todo

config OAP_GPIO_3_ENABLED
    bool "enable GPIO #3"
    default n
    help
        todo   

config OAP_GPIO_OUTPUT3_PIN
    int "GPIO #3 output PIN"
    depends on OAP_GPIO_3_ENABLED
    default 19
    help
        todo

config OAP_GPIO_INPUT3_PIN
    int "GPIO #3 input PIN"
    depends on OAP_GPIO_3_ENABLED
    default 39
    help
        todo

endmenu
```

## components/oap-hw-hc-sr04/Kconfig
```kconfig
menu "OAP HC-SR04 distance sensor"

config OAP_HCSR04_0_ENABLED
    bool "enable ultrasonic distance sensor #0 SR-HC04"
    default y
    help
        todo   

config OAP_HCSR04_TRIGGER0
    int "Trigger 0 output PIN"
    depends on OAP_HCSR04_0_ENABLED
    default 32
    help
        todo

config OAP_HCSR04_ECHO0
    int "Echo 0 input PIN"
    depends on OAP_HCSR04_0_ENABLED
    default 34
    help
        todo

config OAP_HCSR04_1_ENABLED
    bool "enable ultrasonic dinstance sensor #1 SR-HC04"
    default y
    help
        todo   

config OAP_HCSR04_TRIGGER1
    int "Trigger 1 output PIN"
    depends on OAP_HCSR04_1_ENABLED
    default 33
    help
        todo

config OAP_HCSR04_ECHO1
    int "Echo 1 input PIN"
    depends on OAP_HCSR04_1_ENABLED
    default 35
    help
        todo

endmenu
```

## components/oap-hw-mhz19/Kconfig
```kconfig
menu "OAP MH-Z19 CO2 Sensor"

config OAP_MH_ENABLED
    bool "enable MH-Z19 CO2 Sensor"
    default y
    help
        todo   

config OAP_MH_UART_NUM
    hex "uart num"
    depends on OAP_MH_ENABLED
    default 2
    help
        todo

config OAP_MH_UART_RXD_PIN
    int "RX gpio"
    depends on OAP_MH_ENABLED
    default 16
    help
        GPIO pin connected to sensor RX line. This pin can be R/O (>=34).
        
config OAP_MH_UART_TXD_PIN
    int "TX gpio"
    depends on OAP_MH_ENABLED
    default 17
    help
        GPIO pin connected to sensor TX line.
        
endmenu
```

## components/oap-hw-pmsx003/Kconfig
```kconfig
menu "OAP PMSx003 Sensor"

config OAP_PM_UART_ENABLE
    bool "PM0 enable"
    default y
    help
        todo

config OAP_PM_UART_NUM
    hex "uart num"
    depends on OAP_PM_UART_ENABLE
    default 1
    help
        todo

config OAP_PM_SENSOR_CONTROL_PIN
    int "sensor set gpio"
    depends on OAP_PM_UART_ENABLE
    default 10
    help
        R/W GPIO pin connected to sensor SET line - it enables/disables sensor.

config OAP_PM_UART_RXD_PIN
    int "RX gpio"
    depends on OAP_PM_UART_ENABLE
    default 13
    help
        GPIO pin connected to sensor RX line. This pin can be R/O (>=34).
        
config OAP_PM_UART_TXD_PIN
    int "TX gpio"
    depends on OAP_PM_UART_ENABLE
    default 5
    help
        Any gpio pin (no need to connect this line)
        
config OAP_PM_UART_RTS_PIN
    int "RTS gpio"
    depends on OAP_PM_UART_ENABLE
    default 18
    help
        Any gpio pin (no need to connect this line)

config OAP_PM_UART_CTS_PIN
    int "CTS gpio"
    depends on OAP_PM_UART_ENABLE
    default 19
    help
        Any gpio pin (no need to connect this line)

config OAP_PM_UART_AUX_ENABLE
    bool "PM1 enable"
    default y
    help
        todo

config OAP_PM_ENABLED_AUX
    int "enable secondary PM sensor"
    depends on OAP_PM_UART_AUX_ENABLE
    default 0
    help
        todo

config OAP_PM_UART_NUM_AUX
    hex "AUX uart num"
    depends on OAP_PM_UART_AUX_ENABLE
    default 2
    help
        todo

config OAP_PM_SENSOR_CONTROL_PIN_AUX
    int "AUX sensor set gpio"
    depends on OAP_PM_UART_AUX_ENABLE
    default 2
    help
        R/W GPIO pin connected to sensor SET line - it enables/disables sensor.

config OAP_PM_UART_RXD_PIN_AUX
    int "AUX RX gpio"
    depends on OAP_PM_UART_AUX_ENABLE
    default 15
    help
        GPIO pin connected to sensor RX line. This pin can be R/O (>=34).
        
config OAP_PM_UART_TXD_PIN_AUX
    int "AUX TX gpio"
    depends on OAP_PM_UART_AUX_ENABLE
    default 5
    help
        Any gpio pin (no need to connect this line)
        
config OAP_PM_UART_RTS_PIN_AUX
    int "AUX RTS gpio"
    depends on OAP_PM_UART_AUX_ENABLE
    default 18
    help
        Any gpio pin (no need to connect this line)

config OAP_PM_UART_CTS_PIN_AUX
    int "AUX CTS gpio"
    depends on OAP_PM_UART_AUX_ENABLE
    default 19
    help
        Any gpio pin (no need to connect this line)

endmenu
```

## components/oap-hw-ssd1306/Kconfig
```kconfig
menu "OAP SDD1306 OLED Display"

config OAP_SDD1306_ENABLED
    bool "enable SDD1306 OLED Display"
    default y
    help
        todo   
endmenu
```

## components/oap-meter/Kconfig
```kconfig
menu "OAP measurements"

config OAP_PM_SAMPLE_BUF_SIZE
	int "PM sensor sample buffer size"
	default 120
	help		
		Max number of samples that are stored during measurement period. PMSx003 sensor sends ~1 sample / sec.
		If more samples are collected during measurement, older samples get overriden.

config OAP_HEATER_CONTROL_PIN
    int "external heater gpio"
    default -1
    help
        optional GPIO pin to control a heater. It mirrors state of SET gpio. (0 = none)

config OAP_FAN_CONTROL_PIN
    int "external fan gpio"
    default -1
    help
        optional GPIO pin to control an additional fan. It mirrors state of SET gpio. (0 = none)

endmenu
```

## components/oap-ota/Kconfig
```kconfig
menu "OAP OTA updates"

config OAP_OTA_ENABLED
    int "enable OTA updates"
    default 1
    help
        enable automatic over-the-air updates

config OAP_OTA_BIN_URI_PREFIX
    string "bin uri prefix"
    default "https://openairproject.com/ota/"
    help
        This prefix will be used to construct a full URI of a binary with OTA file.
        It is recommended to define as strictly as possible to increase security.
        Malicious index file won't be able to force update from different server / path.

config OAP_OTA_INDEX_URI
    string "index uri"
    default "https://openairproject.com/ota/index.txt""
    help
        full URI to file with OTA definition
        
endmenu
```

## components/oap-wifi/Kconfig
```kconfig
menu "OAP WIFI"
		
config OAP_AP_PASSWORD
	string "AccessPoint password"
	default "cleanair"
	help
		Password to authenticate to WiFi Access Point when sensor runs in this mode.
		Minimum 8 characters.
				
endmenu
```

## components/ota/Kconfig
```kconfig
menu "OAP OTA updates"

config OAP_OTA_ENABLED
    int "enable OTA updates"
    default 1
    help
        todo

config OAP_OTA_BIN_URI_PREFIX
    string "bin uri prefix"
    default "https://github.com/openairproject/sensor-esp32/releases/"
    help
        This prefix will be used to construct a full URI of a binary with OTA file.
        It is recommended to define as strictly as possible to increase security.
        Malicious index file won't be able to force update from different server / path.

config OAP_OTA_INDEX_URI
    string "index uri"
    default "https://raw.githubusercontent.com/openairproject/sensor-esp32/gitota/ota/index.txt"
    help
        full URI to file with OTA definition
        
config OAP_OTA_CHECK_INTERVAL
    int "interval in seconds"
    default 3600
    help
        determines how often sensor will check for OTA update.
        value <= 0 means it will be checked only once during startup.
        
endmenu
```

## components/pmsx003/Kconfig
```kconfig
menu "OAP PMSx003 Sensor"

config OAP_PM_UART_NUM
    hex "uart num"
    default 1
    help
        todo

config OAP_PM_SENSOR_CONTROL_PIN
    int "sensor set gpio"
    default 10
    help
        R/W GPIO pin connected to sensor SET line - it enables/disables sensor.

config OAP_PM_UART_RXD_PIN
    int "RX gpio"
    default 13
    help
        GPIO pin connected to sensor RX line. This pin can be R/O (>=34).
        
config OAP_PM_UART_TXD_PIN
    int "TX gpio"
    default 5
    help
        Any gpio pin (no need to connect this line)
        
config OAP_PM_UART_RTS_PIN
    int "RTS gpio"
    default 18
    help
        Any gpio pin (no need to connect this line)

config OAP_PM_UART_CTS_PIN
    int "CTS gpio"
    default 19
    help
        Any gpio pin (no need to connect this line)

config OAP_HEATER_CONTROL_PIN
    int "external heater gpio"
    default 21
    help
        optional GPIO pin to control a heater. It mirrors state of SET gpio. (0 = none)

config OAP_FAN_CONTROL_PIN
    int "external fan gpio"
    default 22
    help
        optional GPIO pin to control an additional fan. It mirrors state of SET gpio. (0 = none)

config OAP_PM_ENABLED_AUX
    int "enable secondary PM sensor"
    default 0
    help
        todo

config OAP_PM_UART_NUM_AUX
    hex "AUX uart num"
    default 2
    help
        todo

config OAP_PM_SENSOR_CONTROL_PIN_AUX
    int "AUX sensor set gpio"
    default 2
    help
        R/W GPIO pin connected to sensor SET line - it enables/disables sensor.

config OAP_PM_UART_RXD_PIN_AUX
    int "AUX RX gpio"
    default 15
    help
        GPIO pin connected to sensor RX line. This pin can be R/O (>=34).
        
config OAP_PM_UART_TXD_PIN_AUX
    int "AUX TX gpio"
    default 5
    help
        Any gpio pin (no need to connect this line)
        
config OAP_PM_UART_RTS_PIN_AUX
    int "AUX RTS gpio"
    default 18
    help
        Any gpio pin (no need to connect this line)

config OAP_PM_UART_CTS_PIN_AUX
    int "AUX CTS gpio"
    default 19
    help
        Any gpio pin (no need to connect this line)

endmenu
```

## main/Kconfig
```kconfig
menu "OAP Main"

menu "Publishing results"

config OAP_THING_SPEAK_API_KEY
    string "ThingSpeak API KEY"
    default "<NOT_SET>"
    help
        API KEY for your channel obtained from ThingSpeak.com site
    
endmenu    

menu "PM Measurement"

choice OAP_PM_SENSOR_MODE
    bool "used outdoor"
    default OAP_PM_SENSOR_MODE_INDOOR
    help
		PMS sensor has two modes: atmospheric (outdoor) and standard (indoor).
		Mode has to be set manually to properly compensate results.

	config OAP_PM_SENSOR_MODE_OUTDOOR
    	bool "Outdoor"
	config OAP_PM_SENSOR_MODE_INDOOR
    	bool "Indoor"
endchoice    

config OAP_PM_SENSOR_OUTDOOR
    int
    default 0 if OAP_PM_SENSOR_MODE_INDOOR
    default 1 if OAP_PM_SENSOR_MODE_OUTDOOR
    
config OAP_PM_WARM_UP_TIME
	int "PM sensor warm-up time (sec)"
	default 10
	help
		PM sensor starts sending results imediatelly after enabling it (set line), but due
		to its mechanical construction first results are not reliable due to insufficient
		air flow. We ignore samples sends during warm-up period (suggested values: 10-30 sec)
		and let its working conditions to stabilise.

config OAP_PM_MEAS_TIME
	int "PM sensor measurement time (sec)"
	default 30
	help
		Time of a single measurments including warm-up time. Samples collected during this period (after warm-up)
		are be used to compute average result.

config OAP_PM_MEAS_INTERVAL
	int "PM sensor measurement interval (sec)"
	default 300
	help
		Time between subsequent measurements
		
config OAP_PM_SAMPLE_BUF_SIZE
	int "PM sensor sample buffer size"
	default 120
	help		
		Max number of samples that are stored during measurement period. PMSx003 sensor sends ~1 sample / sec.
		If more samples are collected during measurement, older samples get overriden.
		
config OAP_RESULT_BUFFER_SIZE
	int "measurements buffer size"
	default 1
	help		
		Buffer for data that cannot be immediately published because sensor is offline.
		For some services that can accept only real-time data, this should be set to 1.
		
endmenu
		
endmenu
```

## main/Kconfig.projbuild
```kconfig
menu "OpenAirProject"
		
config OAP_CONTROL_PANEL
	int "enable control panel"
	default 1
	help
		Enable web-based control panel where you can configure various parameters of the sensor,
		including wifi and data publishing settings		
		
config OAP_RGB_LED
	bool "enable air quality RGB-LED"
	default y
	help
		Enable air quality RGB-LED. If set to disable the only the blue channel is being used.
endmenu
```
